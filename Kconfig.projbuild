## Kconfig.projbuild
```kconfig
menu "ESP_AI_THINKER_V2_2_BOARD"

config USE_ESP_AI_THINKER_V2_2_BOARD
	bool "Use this custom board?"
	default y
	help
	  If this is not ticked the ESP_AI_THINKER_V2_2_BOARD won't be used.

    config MANUAL_PA_ENABLE
    bool "Manual PA control"
    default n
    help
      Manually enable and disable the power amplifier.

endmenu
```
